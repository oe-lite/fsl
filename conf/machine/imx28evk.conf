## conf/machine/imx28evk.conf
```bitbake
MACHINE_CPU = "arm-imx28"

MACHINE_USE_imxbootlets_board = "iMX28_EVK"
MACHINE_USE_imxbootlets_chipfamily = "imx28"

MACHINE_USE_kernel_imagetype = "uImage"
MACHINE_USE_kernel_uimage_entrypoint = "40008000"
MACHINE_USE_barebox_defconfig = "imx28evk_defconfig"

MACHINE_USE_barebox_custom_env = "barebox-mxs-env"
```

## conf/machine/imx53qsb.conf
```bitbake
MACHINE_CPU	= "arm-imx53"
MACHINE_ABI	= "softfp"

MACHINE_USE_kernel_imagetype = "uImage"
MACHINE_USE_kernel_defconfig = "imx5_defconfig"

MACHINE_USE_uboot_config = "mx53_loco_config"

MACHINE_USE_barebox_defconfig = "freescale_mx53_loco_defconfig"

MACHINE_USE_rootfs_extra_rdepends = "kernel-modules"

MACHINE_USE_hostname = "imx53qsb"
MACHINE_USE_basefiles_issue = "IMX53QSB OE-lite BSP"
```
